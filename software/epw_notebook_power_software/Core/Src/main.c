/* USER CODE BEGIN Header */
/**
  ******************************************************************************
  * @file           : main.c
  * @brief          : Main program body
  ******************************************************************************
  * @attention
  *
  * Copyright (c) 2025 STMicroelectronics.
  * All rights reserved.
  *
  * This software is licensed under terms that can be found in the LICENSE file
  * in the root directory of this software component.
  * If no LICENSE file comes with this software, it is provided AS-IS.
  *
  ******************************************************************************
  */
/* USER CODE END Header */
/* Includes ------------------------------------------------------------------*/
#include "main.h"
#include "usb_device.h"

/* Private includes ----------------------------------------------------------*/
/* USER CODE BEGIN Includes */

/* USER CODE END Includes */

/* Private typedef -----------------------------------------------------------*/
/* USER CODE BEGIN PTD */

/* USER CODE END PTD */

/* Private define ------------------------------------------------------------*/
/* USER CODE BEGIN PD */
#define OLED_ADDRESS 0x78
#define OLED_DATA_ADDRESS 0x40
#define OLED_CMD_ADDRESS 0x00

#define PMBUS_EEPROM_ADDRESS 0xA0
#define PMBUS_MCU_ADDRESS 0xB0
/* USER CODE END PD */

/* Private macro -------------------------------------------------------------*/
/* USER CODE BEGIN PM */

/* USER CODE END PM */

/* Private variables ---------------------------------------------------------*/
ADC_HandleTypeDef hadc1;
DMA_HandleTypeDef hdma_adc1;

I2C_HandleTypeDef hi2c1;
I2C_HandleTypeDef hi2c2;

IWDG_HandleTypeDef hiwdg;

SPI_HandleTypeDef hspi2;

TIM_HandleTypeDef htim1;
TIM_HandleTypeDef htim2;

/* USER CODE BEGIN PV */
//8*6 ASCII字符集点阵
const unsigned char F6x8[][6] =
{
	0x00, 0x00, 0x00, 0x00, 0x00, 0x00,// sp
	0x00, 0x00, 0x00, 0x2f, 0x00, 0x00,// !
	0x00, 0x00, 0x07, 0x00, 0x07, 0x00,// "
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	0x14, 0x14, 0x14, 0x14, 0x14, 0x14,// horiz lines
};

//16*8 ASCII字符集点阵
const unsigned char F8X16[]=
{
 0x00,0x00,0x00,0x00,0x00,0x00,0x00,0x00,0x00,0x00,0x00,0x00,0x00,0x00,0x00,0x00,//sp /0
 0x00,0x00,0x00,0xF8,0x00,0x00,0x00,0x00,0x00,0x00,0x00,0x33,0x30,0x00,0x00,0x00,//!  /1
 0x00,0x10,0x0C,0x06,0x10,0x0C,0x06,0x00,0x00,0x00,0x00,0x00,0x00,0x00,0x00,0x00,//"  /2
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 0x00,0x00,0x00,0x00,0xFF,0x00,0x00,0x00,0x00,0x00,0x00,0x00,0xFF,0x00,0x00,0x00};//|  /93

const unsigned char OLED_BMP_SYS[] =
{
		0xFF,0x01,0x01,0x11,0xF1,0x1D,0x11,0x11,0xC1,0xA1,0xB1,0xA9,0x2D,0x31,0x21,0x21,
		0x01,0x01,0x01,0xF9,0x81,0x81,0x81,0xF1,0x81,0x81,0x81,0x81,0xF9,0x01,0x01,0x01,
		0x03,0x05,0x09,0x11,0x21,0x41,0x81,0x01,0x01,0x01,0x01,0x01,0x01,0x01,0x01,0x01,
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		0x80,0x80,0x80,0x80,0x80,0x80,0x80,0x80,0x80,0x80,0x80,0x80,0x80,0x80,0x80,0xFF
};

const unsigned char OLED_BMP_INIT[] =
{
		0xFF,0x01,0x01,0x01,0x01,0x01,0x01,0x01,0x01,0x01,0x01,0x01,0x01,0x01,0x01,0x01,
		0x01,0x01,0x01,0x01,0x01,0x01,0x01,0x01,0x01,0x01,0x01,0x01,0x01,0x01,0x01,0x01,
		0x01,0x01,0x01,0x01,0x01,0x01,0x01,0x01,0x01,0x01,0x01,0x01,0x01,0x01,0x01,0x01,
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		0x80,0x80,0x80,0x80,0x80,0x80,0x80,0x80,0x80,0x80,0x80,0x80,0x80,0x80,0x80,0xFF
};

static uint8_t SYS_Power_State = 0;

static uint8_t PMBUS_Recv_Buf_PSMI_0x04[2] = {};
static uint8_t PMBUS_Recv_Buf_PSMI_0x1A[1] = {};
static uint8_t PMBUS_Recv_Buf_PSMI_0x98[1] = {};
static uint8_t PMBUS_Recv_Buf_PSMI_0x0E[1] = {};
static uint8_t PMBUS_Recv_Buf_PSMI_0x10[1] = {};
static uint8_t PMBUS_Recv_Buf_PSMI_0x08[1] = {};
static uint8_t PMBUS_Recv_Buf_PSMI_0x0C[1] = {};
static uint8_t PMBUS_Recv_Buf_PSMI_0x12[1] = {};
static uint8_t PMBUS_Recv_Buf_PSMI_0x1E[1] = {};
static uint8_t PMBUS_Recv_Buf_PSMI_0x00[2] = {};
static uint8_t PMBUS_Recv_Buf_PSMI_0x02[2] = {};
static uint8_t PMBUS_Recv_Buf_FRU[255] = {};

uint16_t ADC_Value[11] = {0};
float VCC19V5_VADC = 0, VCC19V5_IADC = 0, Output_19V5_Power = 0;
float VCC12V_SYS_VADC = 0, VCC12V_SB_VADC = 0, VCC5V0_SYS_VADC = 0, VCC3V3_SYS_VADC = 0;
float T_BOOST = 0, T_REAR = 0, T_FRONT = 0;
float T_IN = 0, Vref_IN = 0;

uint32_t SYS_FAN_TACH_Count = 0;
uint32_t SYS_FAN_Speed = 0;
/* USER CODE END PV */

/* Private function prototypes -----------------------------------------------*/
void SystemClock_Config(void);
static void MX_GPIO_Init(void);
static void MX_DMA_Init(void);
static void MX_ADC1_Init(void);
static void MX_I2C1_Init(void);
static void MX_I2C2_Init(void);
static void MX_TIM1_Init(void);
static void MX_SPI2_Init(void);
static void MX_TIM2_Init(void);
static void MX_IWDG_Init(void);
/* USER CODE BEGIN PFP */
void Feed_IWDG(void)
{
	HAL_IWDG_Refresh(&hiwdg);
}
void OLED_Write_Command(uint8_t oled_wr_data)
{
	HAL_I2C_Mem_Write(&hi2c2, OLED_ADDRESS, OLED_CMD_ADDRESS, 1, &oled_wr_data, 1, 10);
}

void OLED_Write_Data(uint8_t oled_wr_data)
{
	HAL_I2C_Mem_Write(&hi2c2, OLED_ADDRESS, OLED_DATA_ADDRESS, 1, &oled_wr_data, 1, 10);
}

void OLED_Clear(void) // 清屏
{
	uint8_t i, j;
	for(i = 0; i < 8; i++)
	{
		OLED_Write_Command(0xB0 + i);
		OLED_Write_Command(0x00);
		OLED_Write_Command(0x10);
		for(j = 0; j < 128; j++)
		{
			OLED_Write_Data(0x00);
		}
	}
}

void Start_OLED(void)
{
	OLED_Write_Command(0xAE);
	OLED_Write_Command(0x00);
	OLED_Write_Command(0x10);
	OLED_Write_Command(0x40);
	OLED_Write_Command(0x81);
	OLED_Write_Command(0xCF);
	OLED_Write_Command(0xA1);
	OLED_Write_Command(0xC8);
	OLED_Write_Command(0xA6);
	OLED_Write_Command(0xA8);
	OLED_Write_Command(0x3F);
	OLED_Write_Command(0xD3);
	OLED_Write_Command(0x00);
	OLED_Write_Command(0xD5);
	OLED_Write_Command(0x80);
	OLED_Write_Command(0xD9);
	OLED_Write_Command(0xF1);
	OLED_Write_Command(0xDA);
	OLED_Write_Command(0x12);
	OLED_Write_Command(0xDB);
	OLED_Write_Command(0x30);
	OLED_Write_Command(0x20);
	OLED_Write_Command(0x02);
	OLED_Write_Command(0x8D);
	OLED_Write_Command(0x14);
	OLED_Write_Command(0xAF);
}

void OLED_Set_Position(uint8_t pos_x, uint8_t pos_y)
{
	OLED_Write_Command(0xB0 + pos_y); // 设置页地址(0-7)
	OLED_Write_Command(((pos_x & 0xF0) >> 4) | 0x10); // 设置列高地址Display Position
	OLED_Write_Command(pos_x & 0x0F); // 设置列低地址Display Position
}

void OLED_Display_On(void) // OLED开显示
{
	OLED_Write_Command(0x8D);
	OLED_Write_Command(0x14);
	OLED_Write_Command(0xAF);
}

void OLED_Display_Off(void) // OLED关显示
{
	OLED_Write_Command(0x8D);
	OLED_Write_Command(0x10);
	OLED_Write_Command(0xAE);
}

void OLED_Fill_Color(void) // OLED亮屏(写0xFF)
{
	uint8_t i, j;
	for(i = 0; i < 8; i++)
	{
		OLED_Write_Command(0xB0 + i);
		OLED_Write_Command(0x00);
		OLED_Write_Command(0x10);
		for(j = 0; j < 128; j++)
		{
			OLED_Write_Data(0xFF);
		}
	}
}

void OLED_Show_Char(uint8_t x, uint8_t y, uint8_t chr, uint8_t size, uint8_t color_turn)
{
	unsigned char c = 0, i = 0;
	c = chr - ' '; // 得到偏移后的值
	if(x > 128 - 1)
	{
		x = 0;
		y = y + 2;
	}
	if(size == 16)
	{
		OLED_Set_Position(x, y);
		for(i = 0; i < 8; i++)
		{
			if(color_turn)
			{
				OLED_Write_Data(~F8X16[c * 16 + i]);
			}
			else
			{
				OLED_Write_Data(F8X16[c * 16 + i]);
			}
		}
		OLED_Set_Position(x, y + 1);
		for(i = 0; i < 8; i++)
		{
			if(color_turn)
			{
				OLED_Write_Data(~F8X16[c * 16 + i + 8]);
			}
			else
			{
				OLED_Write_Data(F8X16[c * 16 + i + 8]);
			}

		}

	}
	else
	{
		OLED_Set_Position(x, y);
		for(i = 0; i < 6; i++)
		{
			if(color_turn)
			{
				OLED_Write_Data(~F6x8[c][i]);
			}
			else
			{
				OLED_Write_Data(F6x8[c][i]);
			}
		}
	}
}

void OLED_Show_String(uint8_t x, uint8_t y, char* chr, uint8_t size, uint8_t color_turn)
{
	uint8_t j = 0;

	while(chr[j] != '\0')
	{
		OLED_Show_Char(x, y, chr[j], size, color_turn);
		if(size == 12)
		{
			x += 6;
		}
		else
		{
			x += 8;
		}
		if(x > 122 && size == 12)
		{
			x = 0;
			y++;
		}
		if(x > 120 && size == 16)
		{
			x = 0;
			y++;
		}
		j++;
	}
}

unsigned int OLED_POW(uint8_t m, uint8_t n)
{
	unsigned int result = 1;
	while(n--)result *= m;
	return result;
}

void OLED_Show_Num(uint8_t x, uint8_t y, unsigned int num, uint8_t len, uint8_t size2, uint8_t color_turn)
{
	uint8_t t, temp;
	uint8_t enshow = 0;
	for(t = 0; t < len; t++)
	{
		temp = (num / OLED_POW(10, len - t - 1)) % 10;
		if(enshow == 0 && t < (len - 1))
		{
			if(temp == 0)
			{
				OLED_Show_Char(x + (size2 / 2) * t, y, ' ', size2, color_turn);
				continue;
			}
			else
			{
				enshow = 1;
			}
		}
	 	OLED_Show_Char(x + (size2 / 2) * t, y, temp + '0', size2, color_turn);
	}
}

void OLED_Show_Decimal(uint8_t x, uint8_t y, float num, uint8_t z_len, uint8_t f_len, uint8_t size2, uint8_t color_turn)
{
	uint8_t t, temp, i = 0;//i为负数标志位
	uint8_t enshow;
	int z_temp, f_temp;
	if(num < 0)
	{
		z_len += 1;
		i = 1;
		num =- num;
	}
	z_temp = (int)num;
	//整数部分
	for(t = 0; t < z_len; t++)
	{
		temp = (z_temp / OLED_POW(10, z_len - t - 1)) % 10;
		if(enshow == 0 && t < (z_len - 1))
		{
			if(temp == 0)
			{
				OLED_Show_Char(x + (size2 / 2) * t, y, ' ', size2, color_turn);
				continue;
			}
			else
			enshow=1;
		}
		OLED_Show_Char(x + (size2 / 2) * t, y, temp + '0', size2, color_turn);
	}
	//小数点
	OLED_Show_Char(x + (size2 / 2) * (z_len), y, '.', size2, color_turn);

	f_temp = (int)((num-z_temp) * (OLED_POW(10, f_len)));
  //小数部分
	for(t = 0; t < f_len; t++)
	{
		temp = (f_temp / OLED_POW(10, f_len - t - 1)) % 10;
		OLED_Show_Char(x + (size2 / 2) * (t + z_len) + 5, y, temp + '0', size2, color_turn);
	}
	if(i == 1)//如果为负，就将最前的一位赋值‘-’
	{
		OLED_Show_Char(x, y, '-', size2, color_turn);
		i = 0;
	}
}

void OLED_Show_BMP(uint8_t bmp)
{
	uint8_t i = 0;
	uint32_t j = 0, j1 = 0;

	if(bmp)
	{
		for(i = 0; i < 8; i++)
		{
			OLED_Set_Position(0, i);
			for(j = 0; j < 128; j++)
			{
				OLED_Write_Data(OLED_BMP_SYS[j1++]);
			}
		}
	}
	else
	{
		for(i = 0; i < 8; i++)
		{
			OLED_Set_Position(0, i);
			for(j = 0; j < 128; j++)
			{
				OLED_Write_Data(OLED_BMP_INIT[j1++]);
			}
		}
	}
}

void OLED_Show_StartMenu(void)
{
	OLED_Show_String(0, 0, "Output", 16, 0);
	OLED_Show_Decimal(0, 2, VCC19V5_VADC, 4, 1, 16, 0);
	OLED_Show_String(48, 2, "V", 16, 0);
	OLED_Show_Decimal(0, 4, VCC19V5_IADC, 4, 1, 16, 0);
	OLED_Show_String(48, 4, "A", 16, 0);
	OLED_Show_Decimal(0, 6, Output_19V5_Power, 4, 1, 16, 0);
	OLED_Show_String(48, 6, "W", 16, 0);

	OLED_Show_String(64, 0, "Vin", 12, 0);
	// OLED_Show_Decimal(90, 0, (float*)PMBUS_Recv_Buf_PSMI_0x08, 4, 1, 12, 0);

	OLED_Show_String(64, 1, "Fan", 12, 0);
	OLED_Show_Num(95, 1, SYS_FAN_Speed, 5, 12, 0);

	OLED_Show_String(64, 2, "T1", 12, 0);
	OLED_Show_Decimal(90, 2, T_FRONT, 4, 1, 12, 0);

	OLED_Show_String(64, 3, "T2", 12, 0);
	OLED_Show_Decimal(90, 3, T_REAR, 4, 1, 12, 0);

	OLED_Show_String(64, 4, "T3", 12, 0);
	OLED_Show_Decimal(90, 4, T_BOOST, 4, 1, 12, 0);

	OLED_Show_String(64, 5, "T4", 12, 0);
	OLED_Show_Decimal(90, 5, T_IN, 4, 1, 12, 0);

	OLED_Show_String(64, 6, "Vref", 12, 0);
	OLED_Show_Decimal(90, 6, Vref_IN, 4, 1, 12, 0);

	OLED_Show_String(64, 7, "PSON  ", 12, 1);
	OLED_Show_Num(95, 7, SYS_Power_State, 5, 12, 1);
}

void PS_Power_Control(uint8_t state) // PSON控制
{
	if(state)
	{
		HAL_GPIO_WritePin(PSON_CTRL_GPIO_Port, PSON_CTRL_Pin, GPIO_PIN_SET);
		SYS_Power_State = 1;
	}
	else
	{
		HAL_GPIO_WritePin(PSON_CTRL_GPIO_Port, PSON_CTRL_Pin, GPIO_PIN_RESET);
		SYS_Power_State = 0;
	}
}

void PMBUS_Read_PSMI(void)
{
	HAL_I2C_Mem_Read(&hi2c1, PMBUS_MCU_ADDRESS, 0x04, 2, PMBUS_Recv_Buf_PSMI_0x04, 1, 10);
	HAL_I2C_Mem_Read(&hi2c1, PMBUS_MCU_ADDRESS, 0x1A, 1, PMBUS_Recv_Buf_PSMI_0x1A, 1, 10);
	HAL_I2C_Mem_Read(&hi2c1, PMBUS_MCU_ADDRESS, 0x98, 1, PMBUS_Recv_Buf_PSMI_0x98, 1, 10);
	HAL_I2C_Mem_Read(&hi2c1, PMBUS_MCU_ADDRESS, 0x0E, 1, PMBUS_Recv_Buf_PSMI_0x0E, 1, 10);
	HAL_I2C_Mem_Read(&hi2c1, PMBUS_MCU_ADDRESS, 0x10, 1, PMBUS_Recv_Buf_PSMI_0x10, 1, 10);
	HAL_I2C_Mem_Read(&hi2c1, PMBUS_MCU_ADDRESS, 0x08, 1, PMBUS_Recv_Buf_PSMI_0x08, 1, 10);
	HAL_I2C_Mem_Read(&hi2c1, PMBUS_MCU_ADDRESS, 0x0C, 1, PMBUS_Recv_Buf_PSMI_0x0C, 1, 10);
	HAL_I2C_Mem_Read(&hi2c1, PMBUS_MCU_ADDRESS, 0x12, 1, PMBUS_Recv_Buf_PSMI_0x12, 1, 10);
	HAL_I2C_Mem_Read(&hi2c1, PMBUS_MCU_ADDRESS, 0x1E, 1, PMBUS_Recv_Buf_PSMI_0x1E, 1, 10);
	HAL_I2C_Mem_Read(&hi2c1, PMBUS_MCU_ADDRESS, 0x00, 2, PMBUS_Recv_Buf_PSMI_0x00, 1, 10);
	HAL_I2C_Mem_Read(&hi2c1, PMBUS_MCU_ADDRESS, 0x02, 2, PMBUS_Recv_Buf_PSMI_0x02, 1, 10);
}

void PMBUS_Read_FRU(void)
{
	HAL_I2C_Mem_Read(&hi2c1, PMBUS_EEPROM_ADDRESS, 0xA1, 255, PMBUS_Recv_Buf_FRU, 1, 10);
}

void USB_CDC_Transmit_PMBUS_PSMI(void)
{
	CDC_Transmit_FS("\n", 1);
	HAL_Delay(1);

	CDC_Transmit_FS("PMBUS_PSMI", 10);
	HAL_Delay(1);
	CDC_Transmit_FS("\n", 1);
	HAL_Delay(1);

	CDC_Transmit_FS("0x04", 4);
	HAL_Delay(1);
	CDC_Transmit_FS("\n", 1);
	HAL_Delay(1);
	CDC_Transmit_FS(PMBUS_Recv_Buf_PSMI_0x04, 2);
	HAL_Delay(1);
	CDC_Transmit_FS("\n", 1);
	HAL_Delay(1);

	CDC_Transmit_FS("0x1A", 4);
	HAL_Delay(1);
	CDC_Transmit_FS("\n", 1);
	HAL_Delay(1);
	CDC_Transmit_FS(PMBUS_Recv_Buf_PSMI_0x1A, 1);
	HAL_Delay(1);
	CDC_Transmit_FS("\n", 1);
	HAL_Delay(1);

	CDC_Transmit_FS("0x98", 4);
	HAL_Delay(1);
	CDC_Transmit_FS("\n", 1);
	HAL_Delay(1);
	CDC_Transmit_FS(PMBUS_Recv_Buf_PSMI_0x98, 1);
	HAL_Delay(1);
	CDC_Transmit_FS("\n", 1);
	HAL_Delay(1);

	CDC_Transmit_FS("0x0E", 4);
	HAL_Delay(1);
	CDC_Transmit_FS("\n", 1);
	HAL_Delay(1);
	CDC_Transmit_FS(PMBUS_Recv_Buf_PSMI_0x0E, 1);
	HAL_Delay(1);
	CDC_Transmit_FS("\n", 1);
	HAL_Delay(1);

	CDC_Transmit_FS("0x10", 4);
	HAL_Delay(1);
	CDC_Transmit_FS("\n", 1);
	HAL_Delay(1);
	CDC_Transmit_FS(PMBUS_Recv_Buf_PSMI_0x10, 1);
	HAL_Delay(1);
	CDC_Transmit_FS("\n", 1);
	HAL_Delay(1);

	CDC_Transmit_FS("0x08", 4);
	HAL_Delay(1);
	CDC_Transmit_FS("\n", 1);
	HAL_Delay(1);
	CDC_Transmit_FS(PMBUS_Recv_Buf_PSMI_0x08, 1);
	HAL_Delay(1);
	CDC_Transmit_FS("\n", 1);
	HAL_Delay(1);

	CDC_Transmit_FS("0x0C", 4);
	HAL_Delay(1);
	CDC_Transmit_FS("\n", 1);
	HAL_Delay(1);
	CDC_Transmit_FS(PMBUS_Recv_Buf_PSMI_0x0C, 1);
	HAL_Delay(1);
	CDC_Transmit_FS("\n", 1);
	HAL_Delay(1);

	CDC_Transmit_FS("0x12", 4);
	HAL_Delay(1);
	CDC_Transmit_FS("\n", 1);
	HAL_Delay(1);
	CDC_Transmit_FS(PMBUS_Recv_Buf_PSMI_0x12, 1);
	HAL_Delay(1);
	CDC_Transmit_FS("\n", 1);
	HAL_Delay(1);

	CDC_Transmit_FS("0x1E", 4);
	HAL_Delay(1);
	CDC_Transmit_FS("\n", 1);
	HAL_Delay(1);
	CDC_Transmit_FS(PMBUS_Recv_Buf_PSMI_0x1E, 1);
	HAL_Delay(1);
	CDC_Transmit_FS("\n", 1);
	HAL_Delay(1);

	CDC_Transmit_FS("0x00", 4);
	HAL_Delay(1);
	CDC_Transmit_FS("\n", 1);
	HAL_Delay(1);
	CDC_Transmit_FS(PMBUS_Recv_Buf_PSMI_0x00, 2);
	HAL_Delay(1);
	CDC_Transmit_FS("\n", 1);
	HAL_Delay(1);

	CDC_Transmit_FS("0x02", 4);
	HAL_Delay(1);
	CDC_Transmit_FS("\n", 1);
	HAL_Delay(1);
	CDC_Transmit_FS(PMBUS_Recv_Buf_PSMI_0x02, 2);
	HAL_Delay(1);
	CDC_Transmit_FS("\n", 1);
	HAL_Delay(1);
}

void USB_CDC_Transmit_PMBUS_FRU(void)
{
	CDC_Transmit_FS("\n", 1);
	HAL_Delay(1);

	CDC_Transmit_FS("PMBUS_FRU", 9);
	HAL_Delay(1);
	CDC_Transmit_FS("\n", 1);
	HAL_Delay(1);

	CDC_Transmit_FS(PMBUS_Recv_Buf_PSMI_0x02, 255);
	HAL_Delay(1);
	CDC_Transmit_FS("\n", 1);
	HAL_Delay(1);
}

void USB_CDC_Transmit_SYS_Status(void)
{
	USB_CDC_Transmit_PMBUS_PSMI();
}

/*
 * SYS_LED_Control
 *
 * 0 = 关闭
 * 1 = 闪烁(1000ms)
 * 2 = 闪烁(500ms)
 * 3 = 常亮
 *
 * 注意：关闭是GPIO_PIN_SET, 打开是GPIO_PIN_RESET
 */
void SYS_LED_Control_Run(uint8_t state)
{
	if(state == 1)
	{
		HAL_GPIO_TogglePin(LED_RUN_GPIO_Port, LED_RUN_Pin);
		HAL_Delay(1000);
	}
	else if(state == 2)
	{
		HAL_GPIO_TogglePin(LED_RUN_GPIO_Port, LED_RUN_Pin);
		HAL_Delay(500);
	}
	else if(state == 3)
	{
		HAL_GPIO_WritePin(LED_RUN_GPIO_Port, LED_RUN_Pin, GPIO_PIN_RESET);
	}
	else
	{
		HAL_GPIO_WritePin(LED_RUN_GPIO_Port, LED_RUN_Pin, GPIO_PIN_SET);
	}
}

void SYS_LED_Control_Fault(uint8_t state)
{
	if(state == 1)
	{
		HAL_GPIO_TogglePin(LED_FAULT_GPIO_Port, LED_FAULT_Pin);
		HAL_Delay(1000);
	}
	else if(state == 2)
	{
		HAL_GPIO_TogglePin(LED_FAULT_GPIO_Port, LED_FAULT_Pin);
		HAL_Delay(500);
	}
	else if(state == 3)
	{
		HAL_GPIO_WritePin(LED_FAULT_GPIO_Port, LED_FAULT_Pin, GPIO_PIN_RESET);
	}
	else
	{
		HAL_GPIO_WritePin(LED_FAULT_GPIO_Port, LED_FAULT_Pin, GPIO_PIN_SET);
	}
}

void SYS_ADC_Convert_Value(void)
{
	VCC12V_SYS_VADC = (float)ADC_Value[0] * Vref_IN / 4096;
	VCC12V_SB_VADC = (float)ADC_Value[1] * Vref_IN / 4096;
	VCC19V5_VADC = (float)ADC_Value[2] * Vref_IN / 4096;
	VCC19V5_IADC = (float)ADC_Value[3] * Vref_IN / 4096;
	T_BOOST = (float)ADC_Value[4] * Vref_IN / 4096;
	T_REAR = (float)ADC_Value[5] * Vref_IN / 4096;
	T_FRONT = (float)ADC_Value[6] * Vref_IN / 4096;
	VCC5V0_SYS_VADC = (float)ADC_Value[7] * Vref_IN / 4096;
	VCC3V3_SYS_VADC = (float)ADC_Value[8] * Vref_IN / 4096;
	T_IN = (float)ADC_Value[9] * Vref_IN / 4096;
	Vref_IN = (float)ADC_Value[10] * 3.3f / 4096;
}

/*
 * 风扇速度控制
 * 风扇速度0-100, 0是最低速度(不一定会停转，看风扇)
 * ARR为1400, 所以这里输入的速度要 * 14.4
 */
void SYS_FAN_Control(uint8_t speed)
{
	uint32_t pwm_speed = 0;
	pwm_speed = speed * 14.4;

	__HAL_TIM_SET_COMPARE(&htim1, TIM_CHANNEL_1, pwm_speed);
}
/* USER CODE END PFP */

/* Private user code ---------------------------------------------------------*/
/* USER CODE BEGIN 0 */

/* USER CODE END 0 */

/**
  * @brief  The application entry point.
  * @retval int
  */
int main(void)
{

  /* USER CODE BEGIN 1 */

  /* USER CODE END 1 */

  /* MCU Configuration--------------------------------------------------------*/

  /* Reset of all peripherals, Initializes the Flash interface and the Systick. */
  HAL_Init();

  /* USER CODE BEGIN Init */

  /* USER CODE END Init */

  /* Configure the system clock */
  SystemClock_Config();

  /* USER CODE BEGIN SysInit */

  /* USER CODE END SysInit */

  /* Initialize all configured peripherals */
  MX_GPIO_Init();
  MX_DMA_Init();
  MX_ADC1_Init();
  MX_I2C1_Init();
  MX_I2C2_Init();
  MX_TIM1_Init();
  MX_USB_DEVICE_Init();
  MX_SPI2_Init();
  MX_TIM2_Init();

  /* USER CODE BEGIN 2 */
  HAL_Delay(500);

  SYS_LED_Control_Fault(3);

  HAL_TIM_PWM_Start(&htim1, TIM_CHANNEL_1);

  HAL_ADCEx_Calibration_Start(&hadc1);
  HAL_Delay(10);
  ADC_Enable(&hadc1);
  HAL_ADC_Start_DMA(&hadc1, (uint32_t*)ADC_Value, 11);

  SYS_FAN_Control(100);

  Start_OLED();
  OLED_Clear();
  OLED_Set_Position(0, 0);
  OLED_Show_BMP(0);

  PMBUS_Read_FRU();

  HAL_Delay(500);

  OLED_Clear();
  SYS_FAN_Control(0);

  HAL_TIM_Base_Start_IT(&htim2);

  HAL_Delay(5000);
  PS_Power_Control(1);
  SYS_LED_Control_Fault(0);
  SYS_LED_Control_Run(1);

  /*
   * 如果用MX重新生成过代码的话，需要在这里初始化IWDG
   */
  MX_IWDG_Init();

  /* USER CODE END 2 */

  /* Infinite loop */
  /* USER CODE BEGIN WHILE */
  while (1)
  {
	  Feed_IWDG();
	  OLED_Show_StartMenu();
    /* USER CODE END WHILE */

    /* USER CODE BEGIN 3 */
  }
  /* USER CODE END 3 */
}

/**
  * @brief System Clock Configuration
  * @retval None
  */
void SystemClock_Config(void)
{
  RCC_OscInitTypeDef RCC_OscInitStruct = {0};
  RCC_ClkInitTypeDef RCC_ClkInitStruct = {0};
  RCC_PeriphCLKInitTypeDef PeriphClkInit = {0};

  /** Initializes the RCC Oscillators according to the specified parameters
  * in the RCC_OscInitTypeDef structure.
  */
  RCC_OscInitStruct.OscillatorType = RCC_OSCILLATORTYPE_LSI|RCC_OSCILLATORTYPE_HSE;
  RCC_OscInitStruct.HSEState = RCC_HSE_ON;
  RCC_OscInitStruct.HSEPredivValue = RCC_HSE_PREDIV_DIV1;
  RCC_OscInitStruct.HSIState = RCC_HSI_ON;
  RCC_OscInitStruct.LSIState = RCC_LSI_ON;
  RCC_OscInitStruct.PLL.PLLState = RCC_PLL_ON;
  RCC_OscInitStruct.PLL.PLLSource = RCC_PLLSOURCE_HSE;
  RCC_OscInitStruct.PLL.PLLMUL = RCC_PLL_MUL9;
  if (HAL_RCC_OscConfig(&RCC_OscInitStruct) != HAL_OK)
  {
    Error_Handler();
  }

  /** Initializes the CPU, AHB and APB buses clocks
  */
  RCC_ClkInitStruct.ClockType = RCC_CLOCKTYPE_HCLK|RCC_CLOCKTYPE_SYSCLK
                              |RCC_CLOCKTYPE_PCLK1|RCC_CLOCKTYPE_PCLK2;
  RCC_ClkInitStruct.SYSCLKSource = RCC_SYSCLKSOURCE_PLLCLK;
  RCC_ClkInitStruct.AHBCLKDivider = RCC_SYSCLK_DIV1;
  RCC_ClkInitStruct.APB1CLKDivider = RCC_HCLK_DIV2;
  RCC_ClkInitStruct.APB2CLKDivider = RCC_HCLK_DIV1;

  if (HAL_RCC_ClockConfig(&RCC_ClkInitStruct, FLASH_LATENCY_2) != HAL_OK)
  {
    Error_Handler();
  }
  PeriphClkInit.PeriphClockSelection = RCC_PERIPHCLK_ADC|RCC_PERIPHCLK_USB;
  PeriphClkInit.AdcClockSelection = RCC_ADCPCLK2_DIV6;
  PeriphClkInit.UsbClockSelection = RCC_USBCLKSOURCE_PLL_DIV1_5;
  if (HAL_RCCEx_PeriphCLKConfig(&PeriphClkInit) != HAL_OK)
  {
    Error_Handler();
  }
}

/**
  * @brief ADC1 Initialization Function
  * @param None
  * @retval None
  */
static void MX_ADC1_Init(void)
{

  /* USER CODE BEGIN ADC1_Init 0 */

  /* USER CODE END ADC1_Init 0 */

  ADC_ChannelConfTypeDef sConfig = {0};

  /* USER CODE BEGIN ADC1_Init 1 */

  /* USER CODE END ADC1_Init 1 */

  /** Common config
  */
  hadc1.Instance = ADC1;
  hadc1.Init.ScanConvMode = ADC_SCAN_ENABLE;
  hadc1.Init.ContinuousConvMode = ENABLE;
  hadc1.Init.DiscontinuousConvMode = DISABLE;
  hadc1.Init.ExternalTrigConv = ADC_SOFTWARE_START;
  hadc1.Init.DataAlign = ADC_DATAALIGN_RIGHT;
  hadc1.Init.NbrOfConversion = 11;
  if (HAL_ADC_Init(&hadc1) != HAL_OK)
  {
    Error_Handler();
  }

  /** Configure Regular Channel
  */
  sConfig.Channel = ADC_CHANNEL_1;
  sConfig.Rank = ADC_REGULAR_RANK_1;
  sConfig.SamplingTime = ADC_SAMPLETIME_1CYCLE_5;
  if (HAL_ADC_ConfigChannel(&hadc1, &sConfig) != HAL_OK)
  {
    Error_Handler();
  }

  /** Configure Regular Channel
  */
  sConfig.Channel = ADC_CHANNEL_2;
  sConfig.Rank = ADC_REGULAR_RANK_2;
  if (HAL_ADC_ConfigChannel(&hadc1, &sConfig) != HAL_OK)
  {
    Error_Handler();
  }

  /** Configure Regular Channel
  */
  sConfig.Channel = ADC_CHANNEL_3;
  sConfig.Rank = ADC_REGULAR_RANK_3;
  if (HAL_ADC_ConfigChannel(&hadc1, &sConfig) != HAL_OK)
  {
    Error_Handler();
  }

  /** Configure Regular Channel
  */
  sConfig.Channel = ADC_CHANNEL_4;
  sConfig.Rank = ADC_REGULAR_RANK_4;
  if (HAL_ADC_ConfigChannel(&hadc1, &sConfig) != HAL_OK)
  {
    Error_Handler();
  }

  /** Configure Regular Channel
  */
  sConfig.Channel = ADC_CHANNEL_5;
  sConfig.Rank = ADC_REGULAR_RANK_5;
  if (HAL_ADC_ConfigChannel(&hadc1, &sConfig) != HAL_OK)
  {
    Error_Handler();
  }

  /** Configure Regular Channel
  */
  sConfig.Channel = ADC_CHANNEL_6;
  sConfig.Rank = ADC_REGULAR_RANK_6;
  if (HAL_ADC_ConfigChannel(&hadc1, &sConfig) != HAL_OK)
  {
    Error_Handler();
  }

  /** Configure Regular Channel
  */
  sConfig.Channel = ADC_CHANNEL_7;
  sConfig.Rank = ADC_REGULAR_RANK_7;
  if (HAL_ADC_ConfigChannel(&hadc1, &sConfig) != HAL_OK)
  {
    Error_Handler();
  }

  /** Configure Regular Channel
  */
  sConfig.Channel = ADC_CHANNEL_8;
  sConfig.Rank = ADC_REGULAR_RANK_8;
  if (HAL_ADC_ConfigChannel(&hadc1, &sConfig) != HAL_OK)
  {
    Error_Handler();
  }

  /** Configure Regular Channel
  */
  sConfig.Channel = ADC_CHANNEL_9;
  sConfig.Rank = ADC_REGULAR_RANK_9;
  if (HAL_ADC_ConfigChannel(&hadc1, &sConfig) != HAL_OK)
  {
    Error_Handler();
  }

  /** Configure Regular Channel
  */
  sConfig.Channel = ADC_CHANNEL_TEMPSENSOR;
  sConfig.Rank = ADC_REGULAR_RANK_10;
  if (HAL_ADC_ConfigChannel(&hadc1, &sConfig) != HAL_OK)
  {
    Error_Handler();
  }

  /** Configure Regular Channel
  */
  sConfig.Channel = ADC_CHANNEL_VREFINT;
  sConfig.Rank = ADC_REGULAR_RANK_11;
  if (HAL_ADC_ConfigChannel(&hadc1, &sConfig) != HAL_OK)
  {
    Error_Handler();
  }
  /* USER CODE BEGIN ADC1_Init 2 */

  /* USER CODE END ADC1_Init 2 */

}

/**
  * @brief I2C1 Initialization Function
  * @param None
  * @retval None
  */
static void MX_I2C1_Init(void)
{

  /* USER CODE BEGIN I2C1_Init 0 */

  /* USER CODE END I2C1_Init 0 */

  /* USER CODE BEGIN I2C1_Init 1 */

  /* USER CODE END I2C1_Init 1 */
  hi2c1.Instance = I2C1;
  hi2c1.Init.ClockSpeed = 100000;
  hi2c1.Init.DutyCycle = I2C_DUTYCYCLE_2;
  hi2c1.Init.OwnAddress1 = 0;
  hi2c1.Init.AddressingMode = I2C_ADDRESSINGMODE_7BIT;
  hi2c1.Init.DualAddressMode = I2C_DUALADDRESS_DISABLE;
  hi2c1.Init.OwnAddress2 = 0;
  hi2c1.Init.GeneralCallMode = I2C_GENERALCALL_DISABLE;
  hi2c1.Init.NoStretchMode = I2C_NOSTRETCH_DISABLE;
  if (HAL_I2C_Init(&hi2c1) != HAL_OK)
  {
    Error_Handler();
  }
  /* USER CODE BEGIN I2C1_Init 2 */

  /* USER CODE END I2C1_Init 2 */

}

/**
  * @brief I2C2 Initialization Function
  * @param None
  * @retval None
  */
static void MX_I2C2_Init(void)
{

  /* USER CODE BEGIN I2C2_Init 0 */

  /* USER CODE END I2C2_Init 0 */

  /* USER CODE BEGIN I2C2_Init 1 */

  /* USER CODE END I2C2_Init 1 */
  hi2c2.Instance = I2C2;
  hi2c2.Init.ClockSpeed = 400000;
  hi2c2.Init.DutyCycle = I2C_DUTYCYCLE_2;
  hi2c2.Init.OwnAddress1 = 0;
  hi2c2.Init.AddressingMode = I2C_ADDRESSINGMODE_7BIT;
  hi2c2.Init.DualAddressMode = I2C_DUALADDRESS_DISABLE;
  hi2c2.Init.OwnAddress2 = 0;
  hi2c2.Init.GeneralCallMode = I2C_GENERALCALL_DISABLE;
  hi2c2.Init.NoStretchMode = I2C_NOSTRETCH_DISABLE;
  if (HAL_I2C_Init(&hi2c2) != HAL_OK)
  {
    Error_Handler();
  }
  /* USER CODE BEGIN I2C2_Init 2 */

  /* USER CODE END I2C2_Init 2 */

}

/**
  * @brief IWDG Initialization Function
  * @param None
  * @retval None
  */
static void MX_IWDG_Init(void)
{

  /* USER CODE BEGIN IWDG_Init 0 */

  /* USER CODE END IWDG_Init 0 */

  /* USER CODE BEGIN IWDG_Init 1 */

  /* USER CODE END IWDG_Init 1 */
  hiwdg.Instance = IWDG;
  hiwdg.Init.Prescaler = IWDG_PRESCALER_4;
  hiwdg.Init.Reload = 4095;
  if (HAL_IWDG_Init(&hiwdg) != HAL_OK)
  {
    Error_Handler();
  }
  /* USER CODE BEGIN IWDG_Init 2 */

  /* USER CODE END IWDG_Init 2 */

}

/**
  * @brief SPI2 Initialization Function
  * @param None
  * @retval None
  */
static void MX_SPI2_Init(void)
{

  /* USER CODE BEGIN SPI2_Init 0 */

  /* USER CODE END SPI2_Init 0 */

  /* USER CODE BEGIN SPI2_Init 1 */

  /* USER CODE END SPI2_Init 1 */
  /* SPI2 parameter configuration*/
  hspi2.Instance = SPI2;
  hspi2.Init.Mode = SPI_MODE_MASTER;
  hspi2.Init.Direction = SPI_DIRECTION_2LINES;
  hspi2.Init.DataSize = SPI_DATASIZE_8BIT;
  hspi2.Init.CLKPolarity = SPI_POLARITY_LOW;
  hspi2.Init.CLKPhase = SPI_PHASE_1EDGE;
  hspi2.Init.NSS = SPI_NSS_HARD_OUTPUT;
  hspi2.Init.BaudRatePrescaler = SPI_BAUDRATEPRESCALER_2;
  hspi2.Init.FirstBit = SPI_FIRSTBIT_MSB;
  hspi2.Init.TIMode = SPI_TIMODE_DISABLE;
  hspi2.Init.CRCCalculation = SPI_CRCCALCULATION_DISABLE;
  hspi2.Init.CRCPolynomial = 10;
  if (HAL_SPI_Init(&hspi2) != HAL_OK)
  {
    Error_Handler();
  }
  /* USER CODE BEGIN SPI2_Init 2 */

  /* USER CODE END SPI2_Init 2 */

}

/**
  * @brief TIM1 Initialization Function
  * @param None
  * @retval None
  */
static void MX_TIM1_Init(void)
{

  /* USER CODE BEGIN TIM1_Init 0 */

  /* USER CODE END TIM1_Init 0 */

  TIM_ClockConfigTypeDef sClockSourceConfig = {0};
  TIM_MasterConfigTypeDef sMasterConfig = {0};
  TIM_OC_InitTypeDef sConfigOC = {0};
  TIM_BreakDeadTimeConfigTypeDef sBreakDeadTimeConfig = {0};

  /* USER CODE BEGIN TIM1_Init 1 */

  /* USER CODE END TIM1_Init 1 */
  htim1.Instance = TIM1;
  htim1.Init.Prescaler = 1;
  htim1.Init.CounterMode = TIM_COUNTERMODE_UP;
  htim1.Init.Period = 1439;
  htim1.Init.ClockDivision = TIM_CLOCKDIVISION_DIV1;
  htim1.Init.RepetitionCounter = 0;
  htim1.Init.AutoReloadPreload = TIM_AUTORELOAD_PRELOAD_DISABLE;
  if (HAL_TIM_Base_Init(&htim1) != HAL_OK)
  {
    Error_Handler();
  }
  sClockSourceConfig.ClockSource = TIM_CLOCKSOURCE_INTERNAL;
  if (HAL_TIM_ConfigClockSource(&htim1, &sClockSourceConfig) != HAL_OK)
  {
    Error_Handler();
  }
  if (HAL_TIM_PWM_Init(&htim1) != HAL_OK)
  {
    Error_Handler();
  }
  sMasterConfig.MasterOutputTrigger = TIM_TRGO_RESET;
  sMasterConfig.MasterSlaveMode = TIM_MASTERSLAVEMODE_DISABLE;
  if (HAL_TIMEx_MasterConfigSynchronization(&htim1, &sMasterConfig) != HAL_OK)
  {
    Error_Handler();
  }
  sConfigOC.OCMode = TIM_OCMODE_PWM1;
  sConfigOC.Pulse = 0;
  sConfigOC.OCPolarity = TIM_OCPOLARITY_HIGH;
  sConfigOC.OCNPolarity = TIM_OCNPOLARITY_HIGH;
  sConfigOC.OCFastMode = TIM_OCFAST_DISABLE;
  sConfigOC.OCIdleState = TIM_OCIDLESTATE_RESET;
  sConfigOC.OCNIdleState = TIM_OCNIDLESTATE_RESET;
  if (HAL_TIM_PWM_ConfigChannel(&htim1, &sConfigOC, TIM_CHANNEL_1) != HAL_OK)
  {
    Error_Handler();
  }
  sBreakDeadTimeConfig.OffStateRunMode = TIM_OSSR_DISABLE;
  sBreakDeadTimeConfig.OffStateIDLEMode = TIM_OSSI_DISABLE;
  sBreakDeadTimeConfig.LockLevel = TIM_LOCKLEVEL_OFF;
  sBreakDeadTimeConfig.DeadTime = 0;
  sBreakDeadTimeConfig.BreakState = TIM_BREAK_DISABLE;
  sBreakDeadTimeConfig.BreakPolarity = TIM_BREAKPOLARITY_HIGH;
  sBreakDeadTimeConfig.AutomaticOutput = TIM_AUTOMATICOUTPUT_DISABLE;
  if (HAL_TIMEx_ConfigBreakDeadTime(&htim1, &sBreakDeadTimeConfig) != HAL_OK)
  {
    Error_Handler();
  }
  /* USER CODE BEGIN TIM1_Init 2 */

  /* USER CODE END TIM1_Init 2 */
  HAL_TIM_MspPostInit(&htim1);

}

/**
  * @brief TIM2 Initialization Function
  * @param None
  * @retval None
  */
static void MX_TIM2_Init(void)
{

  /* USER CODE BEGIN TIM2_Init 0 */

  /* USER CODE END TIM2_Init 0 */

  TIM_ClockConfigTypeDef sClockSourceConfig = {0};
  TIM_MasterConfigTypeDef sMasterConfig = {0};

  /* USER CODE BEGIN TIM2_Init 1 */

  /* USER CODE END TIM2_Init 1 */
  htim2.Instance = TIM2;
  htim2.Init.Prescaler = 7200-1;
  htim2.Init.CounterMode = TIM_COUNTERMODE_UP;
  htim2.Init.Period = 10000-1;
  htim2.Init.ClockDivision = TIM_CLOCKDIVISION_DIV1;
  htim2.Init.AutoReloadPreload = TIM_AUTORELOAD_PRELOAD_DISABLE;
  if (HAL_TIM_Base_Init(&htim2) != HAL_OK)
  {
    Error_Handler();
  }
  sClockSourceConfig.ClockSource = TIM_CLOCKSOURCE_INTERNAL;
  if (HAL_TIM_ConfigClockSource(&htim2, &sClockSourceConfig) != HAL_OK)
  {
    Error_Handler();
  }
  sMasterConfig.MasterOutputTrigger = TIM_TRGO_RESET;
  sMasterConfig.MasterSlaveMode = TIM_MASTERSLAVEMODE_DISABLE;
  if (HAL_TIMEx_MasterConfigSynchronization(&htim2, &sMasterConfig) != HAL_OK)
  {
    Error_Handler();
  }
  /* USER CODE BEGIN TIM2_Init 2 */

  /* USER CODE END TIM2_Init 2 */

}

/**
  * Enable DMA controller clock
  */
static void MX_DMA_Init(void)
{

  /* DMA controller clock enable */
  __HAL_RCC_DMA1_CLK_ENABLE();

  /* DMA interrupt init */
  /* DMA1_Channel1_IRQn interrupt configuration */
  HAL_NVIC_SetPriority(DMA1_Channel1_IRQn, 0, 0);
  HAL_NVIC_EnableIRQ(DMA1_Channel1_IRQn);

}

/**
  * @brief GPIO Initialization Function
  * @param None
  * @retval None
  */
static void MX_GPIO_Init(void)
{
  GPIO_InitTypeDef GPIO_InitStruct = {0};
/* USER CODE BEGIN MX_GPIO_Init_1 */
/* USER CODE END MX_GPIO_Init_1 */

  /* GPIO Ports Clock Enable */
  __HAL_RCC_GPIOC_CLK_ENABLE();
  __HAL_RCC_GPIOD_CLK_ENABLE();
  __HAL_RCC_GPIOA_CLK_ENABLE();
  __HAL_RCC_GPIOB_CLK_ENABLE();

  /*Configure GPIO pin Output Level */
  HAL_GPIO_WritePin(PSON_CTRL_GPIO_Port, PSON_CTRL_Pin, GPIO_PIN_RESET);

  /*Configure GPIO pin Output Level */
  HAL_GPIO_WritePin(LED_FAULT_GPIO_Port, LED_FAULT_Pin, GPIO_PIN_RESET);

  /*Configure GPIO pin Output Level */
  HAL_GPIO_WritePin(LED_RUN_GPIO_Port, LED_RUN_Pin, GPIO_PIN_SET);

  /*Configure GPIO pin : PA9 */
  GPIO_InitStruct.Pin = GPIO_PIN_9;
  GPIO_InitStruct.Mode = GPIO_MODE_IT_RISING_FALLING;
  GPIO_InitStruct.Pull = GPIO_PULLUP;
  HAL_GPIO_Init(GPIOA, &GPIO_InitStruct);

  /*Configure GPIO pin : PSON_CTRL_Pin */
  GPIO_InitStruct.Pin = PSON_CTRL_Pin;
  GPIO_InitStruct.Mode = GPIO_MODE_OUTPUT_PP;
  GPIO_InitStruct.Pull = GPIO_PULLDOWN;
  GPIO_InitStruct.Speed = GPIO_SPEED_FREQ_LOW;
  HAL_GPIO_Init(PSON_CTRL_GPIO_Port, &GPIO_InitStruct);

  /*Configure GPIO pin : PSOK_SIG_Pin */
  GPIO_InitStruct.Pin = PSOK_SIG_Pin;
  GPIO_InitStruct.Mode = GPIO_MODE_INPUT;
  GPIO_InitStruct.Pull = GPIO_NOPULL;
  HAL_GPIO_Init(PSOK_SIG_GPIO_Port, &GPIO_InitStruct);

  /*Configure GPIO pins : LED_FAULT_Pin LED_RUN_Pin */
  GPIO_InitStruct.Pin = LED_FAULT_Pin|LED_RUN_Pin;
  GPIO_InitStruct.Mode = GPIO_MODE_OUTPUT_PP;
  GPIO_InitStruct.Pull = GPIO_NOPULL;
  GPIO_InitStruct.Speed = GPIO_SPEED_FREQ_LOW;
  HAL_GPIO_Init(GPIOB, &GPIO_InitStruct);

  /* EXTI interrupt init*/
  HAL_NVIC_SetPriority(EXTI9_5_IRQn, 0, 0);
  HAL_NVIC_EnableIRQ(EXTI9_5_IRQn);

/* USER CODE BEGIN MX_GPIO_Init_2 */
/* USER CODE END MX_GPIO_Init_2 */
}

/* USER CODE BEGIN 4 */

/* USER CODE END 4 */

/**
  * @brief  This function is executed in case of error occurrence.
  * @retval None
  */
void Error_Handler(void)
{
  /* USER CODE BEGIN Error_Handler_Debug */
  /* User can add his own implementation to report the HAL error return state */
  __disable_irq();
  while (1)
  {
  }
  /* USER CODE END Error_Handler_Debug */
}

#ifdef  USE_FULL_ASSERT
/**
  * @brief  Reports the name of the source file and the source line number
  *         where the assert_param error has occurred.
  * @param  file: pointer to the source file name
  * @param  line: assert_param error line source number
  * @retval None
  */
void assert_failed(uint8_t *file, uint32_t line)
{
  /* USER CODE BEGIN 6 */
  /* User can add his own implementation to report the file name and line number,
     ex: printf("Wrong parameters value: file %s on line %d\r\n", file, line) */
  /* USER CODE END 6 */
}
#endif /* USE_FULL_ASSERT */
